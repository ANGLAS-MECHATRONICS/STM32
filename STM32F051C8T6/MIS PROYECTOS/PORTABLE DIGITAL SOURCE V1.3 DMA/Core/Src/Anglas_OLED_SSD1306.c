/*
 * Anglas_OLED_SSD1306.c
 *
 *  Created on: Oct 25, 2022
 *      Author: PC
 */

/* Includes ------------------------------------------------------------------*/
#include "main.h"
#include "Anglas_OLED_SSD1306.h"
/* Exported types ------------------------------------------------------------*/
/* Exported constant ---------------------------------------------------------*/
/* Exported macros -----------------------------------------------------------*/
/* Private macros ------------------------------------------------------------*/
/* Variables -----------------------------------------------------------------*/
/* Private functions ---------------------------------------------------------*/
/* Exported functions --------------------------------------------------------*/
const uint8_t FONT_1[552] =       //Matriz de 1x552 (1fila-552columnas) y lo ordeno en funcion a columnas de 6 en 6 (por el ancho del FONT_1)
{
	0x00, 0x00, 0x00, 0x00, 0x00, 0x00,   // sp      6x0=0  (posicion de inicio del arreglo)
	0x00, 0x00, 0x00, 0x2f, 0x00, 0x00,   // !		 6x1=6  (posicion de inicio del arreglo)
	0x00, 0x00, 0x07, 0x00, 0x07, 0x00,   // "		 6x2=12 (posicion de inicio del arreglo)
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	0x14, 0x14, 0x14, 0x14, 0x14, 0x14    // horiz lines
};


const uint8_t FONT_2[1710] =      //Matriz de 1x1710 (1fila-1710columnas) y lo ordeno en funcion a columnas de 18 en 18 (por el ancho del (FONT_2*2) ya que usara 16pixeles de alto que son 2 paginas)
{   //Para dibujar los caracteres: las 9 primeras columnas van a la pag0 col0,col1,....,col7 y las siguientes 9 columnas van a la pag1 col0,col1,....,col7
	0x00, 0x00, 0x00, 0x00, 0x00, 0x00, 0x00, 0x00, 0x00, 0x00, 0x00, 0x00, 0x00, 0x00, 0x00, 0x00, 0x00, 0x00,// 20  32     18x0=0   (posicion de inicio del arreglo)
	0x00, 0x00, 0x3E, 0xFF, 0xFF, 0x3E, 0x00, 0x00, 0x00, 0x00, 0x00, 0x00, 0x33, 0x33, 0x00, 0x00, 0x00, 0x00,// 21  33 !   18x1=18  (posicion de inicio del arreglo)
	0x00, 0x07, 0x07, 0x00, 0x00, 0x07, 0x07, 0x00, 0x00, 0x00, 0x00, 0x00, 0x00, 0x00, 0x00, 0x00, 0x00, 0x00,// 22  34 "   18x2=36  (posicion de inicio del arreglo)
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	0x02, 0x02, 0x01, 0x01, 0x02, 0x02, 0x01, 0x01, 0x00, 0x00, 0x00, 0x00, 0x00, 0x00, 0x00, 0x00, 0x00, 0x00 // 7E 126 ~
};

const uint8_t FONT_3[5760] =
{
        0x00, 0x00, 0x00, 0x00, 0x00, 0x00, 0x00, 0x00, 0x00, 0x00, 0x00, 0x00,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 0x00,  // Code for char
        0x00, 0x00, 0x00, 0x00, 0x00, 0x00, 0xFE, 0x1F, 0xF0, 0xFE, 0xFF, 0xF7,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 0x00,  // Code for char !
        0x00, 0x00, 0x00, 0xFE, 0x00, 0x00, 0xFE, 0x01, 0x00, 0xFE, 0x01, 0x00, 0xFE, 0x00, 0x00, 0x00, 0x00, 0x00, 0x00, 0x00, 0x00, 0xFE, 0x00, 0x00, 0xFE, 0x01, 0x00, 0xFE, 0x01, 0x00, 0xFE, 0x00, 0x00, 0x00, 0x00, 0x00, 0x00, 0x00, 0x00, 0x00, 0x00, 0x00, 0x00, 0x00, 0x00, 0x00, 0x00, 0x00, 0x00, 0x00, 0x00, 0x00, 0x00, 0x00, 0x00, 0x00, 0x00, 0x00, 0x00, 0x00,  // Code for char "
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        0x00, 0x00, 0x00, 0xFF, 0xFF, 0x7F, 0xFF, 0xFF, 0x7F, 0x01, 0x00, 0x60,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 0x00, 0x00   // Code for char 
        };
////////////////////////// EMPEZAMOS CON LA INICIALIZACION///////////////////////////////////////////////
//La direccion del OLED es la siguiente (depende del pin SA0 si esta conectado a GND o VCC):
//011110 + SA0=0 + R/W=0 ---> 0b01111000 = 0x78
//011110 + SA0=1 + R/W=0 ---> 0b01111010 = 0x7A

//Ahora debemos saber si vamos a mandar un byte de datos que sera: un COMANDO ó datos que se almacenaran en la GDDRAM (ram del oled)
//Para esto necesitamos tener el control de estos bits
	//bit7 -> Co=0  : la transmicion de la siguiente informacion sera un "byte de datos"
	//bit6 -> D/C#=0: el "byte de datos" actuara como un comando(CMD)
	//bit5 al bit0 se llena de ceros
	//0b00000000 = 0x00

	//bit 7 -> Co=0  : la transmicion de la siguiente informacion sera un "byte de datos"
	//bit 6 -> D/C#=1: el "byte de datos" sera un dato almacenado en la GDDRAM (DAT)
	//bit5 al bit0 se llena de ceros
	//0b01000000 = 0x40

//Funcion para mandar un byte de datos que actuara como "comando" o "dato"


void OLED_Init_DMA(void){

	uint8_t datos[26];

	datos[0]  = CMD;
	datos[1]  = SSD1306_DISPLAYOFF;//0xAE
	datos[2]  = SSD1306_SETDISPLAYCLOCKDIV;   //0xD5;
	datos[3]  = 0x80;//0x80
	datos[4]  = SSD1306_SETMULTIPLEX;//0xA8
	datos[5]  = (SSD1306_LCDHEIGHT-1);		   //0x3F  ----> 64 (0-63) valores 63=0x3F
	datos[6]  = SSD1306_SETDISPLAYOFFSET;     //0xD3
	datos[7]  = 0x00;						   //0x00
	datos[8]  = (SSD1306_SETSTARTLINE | 0x00);  //0x40 ----> empezamos en la linea cero
	datos[9]  = SSD1306_CHARGEPUMP;		   //0x8D
	datos[10] = 0x14;						   //0x14 ----> VCC generado por el circuito interno de step up que eleva el voltaje de alimentacion a 7.5V para los pixeles del oled
	datos[11] = SSD1306_MEMORYMODE;		   //0x20
	datos[12] = HORIZONTAL_ADDRESSING_MODE;   //Modo de direccionamiento horizontal
	datos[13] = (SSD1306_SEGREMAP | COLUMN_ADDRESS_0_MAPPED_TO_SEG127);	   //0xA1
	datos[14] = (SET_COM_OUTPUT_SCAN_DIRECTION | SCAN_FROM_COM63_TO_0);	   //0xC8
	datos[15] = SSD1306_SETCOMPINS;		   //0xDA

	switch(SSD1306_LCDHEIGHT){			//0x12 ----> 128*64:0x12   128*32:0x02
		case 32: datos[16] = 0x02;break;
		case 64: datos[16] = 0x12;break;
	}

	datos[17] = SSD1306_SETCONTRAST;		   //0x81
	datos[18] = 0xCF;						   //0xCF
	datos[19] = SSD1306_SETPRECHARGE;         //0xD9
	datos[20] = 0xF1;						   //0xF1
	datos[21] = SET_VCOMH_LEVEL;			   //0xDB
	datos[22] = 0x40;						   //0x40
	datos[23] = SET_ENTIRE_DISPLAY_ON;        //0xA4
	datos[24] = SSD1306_NORMALDISPLAY;	       //0xA6
	datos[25] = SSD1306_DISPLAYON;			   //0xAF -----> enciendo el display

	HAL_Delay(100);

	HAL_I2C_Master_Transmit_DMA(&hi2c1, SSD1306_I2C_ADDRESS, (uint8_t*)datos, 26);
	while (HAL_I2C_GetState(&hi2c1) != HAL_I2C_STATE_READY) {}

	OLED_Clear_DMA();
}

static void OLED_Write_Command_3bytes(uint8_t byte1, uint8_t byte2, uint8_t byte3){
	uint8_t datos[4] = {CMD, byte1, byte2, byte3};
	HAL_I2C_Master_Transmit_DMA(&hi2c1, SSD1306_I2C_ADDRESS, (uint8_t*)datos, 4);
	while (HAL_I2C_GetState(&hi2c1) != HAL_I2C_STATE_READY) {}
}

static void OLED_Write_Data_1byte(uint8_t byte1){
	uint8_t datos[2] = {DAT, byte1};
	HAL_I2C_Master_Transmit_DMA(&hi2c1, SSD1306_I2C_ADDRESS, (uint8_t*)datos, 2);
	while (HAL_I2C_GetState(&hi2c1) != HAL_I2C_STATE_READY) {}
}

static void OLED_Draw_Pixel(uint8_t pag_inicio, uint8_t pag_final, uint8_t col_inicio, uint16_t col_final, uint8_t pixel){
	uint8_t datos[2];
	OLED_Write_Command_3bytes(SSD1306_PAGEADDR,pag_inicio,pag_final);
	OLED_Write_Command_3bytes(SSD1306_COLUMNADDR,col_inicio,col_final);

	datos[0] = DAT;
	datos[1] = pixel;

	HAL_I2C_Master_Transmit_DMA(&hi2c1, SSD1306_I2C_ADDRESS, (uint8_t*)datos, 2);
	while (HAL_I2C_GetState(&hi2c1) != HAL_I2C_STATE_READY) {}
}

//Para limpiar la pantalla oled, esta funcion va desde la pag 0 hasta la pag 7
//Para la columna el datasheet menciona (en modo de direccionamiento horizontal):
//Si el puntero de la dirección de la columna alcanza la dirección final de la columna, el puntero de la dirección de la columna se restablece a la dirección de inicio de la columna y el puntero de dirección de página aumenta en 1.
//Es por eso que pongo de la columna 0 hasta la columna 1023(128columnas*8paginas)
void OLED_Clear_DMA(void){
	uint8_t  pag_inicio = 0;
	uint8_t  pag_final = ((SSD1306_LCDHEIGHT/8)-1);//128x32:4paginas(0-3)    128x64:8paginas(0-7)
	uint8_t  col_inicio = 0;
	uint16_t col_final = ((SSD1306_LCDWIDTH*SSD1306_LCDHEIGHT/8)-1);//128x32:512pixeles/pagina (0-511)   128x64:1024pixeles/pagina (0-1023)
	uint8_t  pixel = 0;//lleno de ceros todos los pixeles
	//una pagina tiene 8pixeles de alto, entonces 128x8=1024, hay 1024 pixeles por pagina(cantidad de datos a enviar para limpiar la pantalla por cada pagina)
	//128x32: DAT +  512datos = 513
	//128x64: DAT + 1024datos = 1025
	//Es por eso que al tamaño de los datos[] a enviar le aumento 2
	uint8_t datos[col_final+2];

	OLED_Write_Command_3bytes(SSD1306_PAGEADDR,pag_inicio,pag_final);
	OLED_Write_Command_3bytes(SSD1306_COLUMNADDR,col_inicio,col_final);

	datos[0] = DAT;

	for(int j=col_inicio;j<=col_final;j++){
		datos[j+1] = pixel;//dato[1], dato[2], dato[3], .... , dato[1023]
		//HAL_Delay(10); //descomentar para probar la libreria y ver la impresion de pixeles de manera lenta
	}

	HAL_I2C_Master_Transmit_DMA(&hi2c1, SSD1306_I2C_ADDRESS, (uint8_t*)datos, col_final+2);
	while (HAL_I2C_GetState(&hi2c1) != HAL_I2C_STATE_READY) {}
}

static void OLED_Draw_8_Pixel(uint8_t pag_inicio, uint8_t col_inicio, uint8_t pixel_8bits){
	OLED_Write_Command_3bytes(SSD1306_PAGEADDR,pag_inicio,pag_inicio);
	OLED_Write_Command_3bytes(SSD1306_COLUMNADDR,col_inicio,col_inicio);
	OLED_Write_Data_1byte(pixel_8bits);
}

static void OLED_Print_Letra(uint8_t pag, uint8_t col, uint8_t font_size, char letra){ //pagina(0,7)  columna(0-127)    letra
	uint16_t pos;     //variable para almacenar la posicion recuperada de la matriz o arreglo
	letra = letra-32; //resto menos 32 para tener el codigo ASCCI

	switch(font_size){
		case 1:
				pos = letra * FONT_1_WIDTH;  //me ubico en su array correcto multiplicando por 6
				for(int i=col; i<col+FONT_1_WIDTH; i++) {
					OLED_Draw_8_Pixel(pag,i,FONT_1[pos]);
					pos++;
				}
			break;
		//////////////////////////////////////////////////////////////////////////////////////////////////
		case 2:
				pos = letra * (FONT_2_WIDTH*2);  //me ubico en su array correcto multiplico por 2 ya que la altura sera de 16pixeles utilizando 8pixles por pagina y en total usara 2 paginas

				for(int i=col; i<col+FONT_2_WIDTH; i++) {       //9
					OLED_Draw_8_Pixel(pag,i,FONT_2[pos]);
					pos++;
				}

				for(int i=col; i<col+FONT_2_WIDTH; i++) {      //9
					OLED_Draw_8_Pixel(pag+1,i,FONT_2[pos]);
					pos++;
				}
			break;
		//////////////////////////////////////////////////////////////////////////////////////////////////
		case 3:
		pos = letra * (FONT_3_WIDTH*3);  //me ubico en su array correcto multiplico por 2 ya que la altura sera de 16pixeles utilizando 8pixles por pagina y en total usara 2 paginas
		//ya que la matriz de FONT3[] que encontre en internet esta organizado de otra manera, realizo el siguiente codigo adecuandome a esa organizacion matricial
		uint16_t pos2 = (letra * (FONT_3_WIDTH*3))+1;
		uint16_t pos3 = (letra * (FONT_3_WIDTH*3))+2;

		for(int i=col; i<col+FONT_3_WIDTH; i++) {
			OLED_Draw_8_Pixel(pag,i,FONT_3[pos]);
			pos+=3;
		}

		for(int i=col; i<col+FONT_3_WIDTH; i++) {
			OLED_Draw_8_Pixel(pag+1,i,FONT_3[pos2]);
			pos2+=3;
		}

		for(int i=col; i<col+FONT_3_WIDTH; i++) {
			OLED_Draw_8_Pixel(pag+2,i,FONT_3[pos3]);
			pos3+=3;
		}
		break;
    }
}


void OLED_Print_Text_DMA(uint8_t pag, uint8_t col, uint8_t font_size, char *texto){

	switch(font_size){
		case 1:
				while(*texto != '\0'){
					OLED_Print_Letra(pag,col,1,*texto++);
					col=col+FONT_1_WIDTH; //aumento la posicion de la columna
				}
			break;
		//////////////////////////////////////////////////////////////////////////
		case 2:
				while(*texto != '\0'){
					OLED_Print_Letra(pag,col,2,*texto++);
					col=col+FONT_2_WIDTH; //aumento la posicion de la columna 9/11
				}
			break;
		///////////////////////////////////////////////////////////////////////////
		case 3:
				while(*texto != '\0'){
					OLED_Print_Letra(pag,col,3,*texto++);
					col=col+FONT_3_WIDTH; //aumento la posicion de la columna 9/11
		}
		break;
		///////////////////////////////////////////////////////////////////////////
	}
}

void OLED_Imagen_DMA(const unsigned char imagen[]){

	int k=0;

	for(int i=0;i<8;i++){
		for(int j=0;j<128;j++){
			OLED_Draw_Pixel(i,i, j,j, imagen[k]);
			k++;
		}
	}
}

void OLED_Imagen_Small_DMA(uint8_t pag, uint8_t col, const unsigned char imagen[], uint8_t size_x, uint8_t size_y){

	int k=0;

//	for(int i=pag;i<size_y/8;i++){
//		for(int j=col;j<col+size_x;j++){
//			OLED_Draw_Pixel(pag,size_y/8, col,col+size_x, imagen[k]);
//			k++;
//		}
//	}

	for(int i=pag;i<pag+size_y/8;i++){
		for(int j=col;j<col+size_x;j++){
			OLED_Draw_Pixel(i,i, j,j, imagen[k]);
			k++;
		}
	}
}
