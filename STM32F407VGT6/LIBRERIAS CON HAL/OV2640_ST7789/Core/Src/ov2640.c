#include "ov2640.h"
#include "main.h"

extern I2C_HandleTypeDef hi2c2;

/* Initialization sequence for QVGA resolution (320x240, RGB565) */


#define OV2640_SENSOR_COM7              0x12
#define OV2640_DSP_RA_DLMT              0xFF


const unsigned char OV2640_320x240_JPEG[][2]=
{
  0xff, 0x01,
  0x12, 0x40,
  0x17, 0x11,
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  0xe0, 0x00,
};



const unsigned char OV2640_QVGA[][2]=
{
  {0xff, 0x00},  {0x2c, 0xff},  {0x2e, 0xdf},  {0xff, 0x01},  {0x3c, 0x32},  {0x11, 0x00},
  {0x09, 0x02},  {0x04, 0xF8}, //mirror
  {0x13, 0xe5},  {0x14, 0x48},  {0x2c, 0x0c},  {0x33, 0x78},  {0x3a, 0x33},
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  {0x00, 0x00},
};


const unsigned char OV2640_JPEG_INIT[][2] = { { 0xff, 0x00 }, { 0x2c, 0xff }, {
		0x2e, 0xdf }, { 0xff, 0x01 }, { 0x3c, 0x32 }, { 0x11, 0x00 }, { 0x09,
		0x02 }, { 0x04, 0x28 }, { 0x13, 0xe5 }, { 0x14, 0x48 }, { 0x2c, 0x0c },
		{ 0x33, 0x78 }, { 0x3a, 0x33 }, { 0x3b, 0xfB }, { 0x3e, 0x00 }, { 0x43,
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				0x2c }, { 0x5b, 0x24 }, { 0x5c, 0x00 },  };

const unsigned char OV2640_YUV422[][2] = { { 0xFF, 0x00 }, { 0x05, 0x00 }, {
		0xDA, 0x10 }, { 0xD7, 0x03 }, { 0xDF, 0x00 }, { 0x33, 0x80 }, { 0x3C,
		0x40 }, { 0xe1, 0x77 }, { 0x00, 0x00 },  };

const unsigned char OV2640_JPEG[][2] = { { 0xe0, 0x14 }, { 0xe1, 0x77 }, { 0xe5,
		0x1f }, { 0xd7, 0x03 }, { 0xda, 0x10 }, { 0xe0, 0x00 }, { 0xFF, 0x01 },
		//{ 0x04, 0x08 }, { 0xff, 0xff }, };
		{ 0x04, 0xF8 },  };

const unsigned char OV2640_1280x960_JPEG[][2] = { { 0xFF, 0x01 },
		{ 0x11, 0x01 }, { 0x12, 0x00 }, { 0x17, 0x11 }, { 0x18, 0x75 }, { 0x32,
				0x36 }, { 0x19, 0x01 }, { 0x1a, 0x97 }, { 0x03, 0x0f }, { 0x37,
				0x40 }, { 0x4f, 0xbb }, { 0x50, 0x9c }, { 0x5a, 0x57 }, { 0x6d,
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				0x01 }, { 0xd3, 0x02 }, { 0xe0, 0x00 },  };

void CAMERA_IO_Write(uint8_t deviceAddr, uint8_t reg, uint8_t value)
{
	HAL_I2C_Mem_Write(&hi2c2, deviceAddr, reg, I2C_MEMADD_SIZE_8BIT, &value, 1, 100);
}
void CAMERA_Delay(uint32_t Delay)
{
	HAL_Delay(Delay);
}

void ov2640_Init(uint16_t DeviceAddr, uint8_t action)
{
  uint32_t index;

  //  HAL_GPIO_WritePin(RST_CAM_GPIO_Port, RST_CAM_Pin, GPIO_PIN_SET);
  //  HAL_GPIO_WritePin(PWDN_CAM_GPIO_Port, PWDN_CAM_Pin, GPIO_PIN_RESET);
//hardware and software init
  HAL_GPIO_WritePin(PWDN_CAM_GPIO_Port, PWDN_CAM_Pin, GPIO_PIN_RESET);  //power on
  HAL_Delay(1);
  HAL_GPIO_WritePin(RST_CAM_GPIO_Port, RST_CAM_Pin, GPIO_PIN_RESET);  //hardware reset
  HAL_Delay(1);
  HAL_GPIO_WritePin(RST_CAM_GPIO_Port, RST_CAM_Pin, GPIO_PIN_SET);
  HAL_Delay(1);

  /* Prepare the camera to be configured */
  CAMERA_IO_Write(DeviceAddr, OV2640_DSP_RA_DLMT, 0x01);
  CAMERA_IO_Write(DeviceAddr, OV2640_SENSOR_COM7, 0x80);
  CAMERA_Delay(20);

  /* Initialize OV2640 */
  switch (action)
  {
  case CAMERA_Movie:
	  for(index=0; index<(sizeof(OV2640_JPEG_INIT)/2); index++)
	  {
		  CAMERA_IO_Write(DeviceAddr, OV2640_JPEG_INIT[index][0], OV2640_JPEG_INIT[index][1]);
		  CAMERA_Delay(1);
	  }

	for(index=0; index<(sizeof(OV2640_YUV422)/2); index++)
	{
		CAMERA_IO_Write(DeviceAddr, OV2640_YUV422[index][0], OV2640_YUV422[index][1]);
	  	CAMERA_Delay(1);
	}

	for(index=0; index<(sizeof(OV2640_JPEG)/2); index++)
	{
		CAMERA_IO_Write(DeviceAddr, OV2640_JPEG[index][0], OV2640_JPEG[index][1]);
		CAMERA_Delay(1);
	}

	for(index=0; index<(sizeof(OV2640_320x240_JPEG)/2); index++)
	{
		CAMERA_IO_Write(DeviceAddr, OV2640_320x240_JPEG[index][0], OV2640_320x240_JPEG[index][1]);
		CAMERA_Delay(1);
	}
	break;
  case CAMERA_Monitor:
    {
      for(index=0; index<(sizeof(OV2640_QVGA)/2); index++)
      {
        CAMERA_IO_Write(DeviceAddr, OV2640_QVGA[index][0], OV2640_QVGA[index][1]);
        CAMERA_Delay(1);
      }
      break;
    }
  case CAMERA_Picture:
  	  for(index=0; index<(sizeof(OV2640_JPEG_INIT)/2); index++)
  	  {
  		  CAMERA_IO_Write(DeviceAddr, OV2640_JPEG_INIT[index][0], OV2640_JPEG_INIT[index][1]);
  		  CAMERA_Delay(1);
  	  }

  	for(index=0; index<(sizeof(OV2640_YUV422)/2); index++)
  	{
  		CAMERA_IO_Write(DeviceAddr, OV2640_YUV422[index][0], OV2640_YUV422[index][1]);
  	  	CAMERA_Delay(1);
  	}

  	for(index=0; index<(sizeof(OV2640_JPEG)/2); index++)
  	{
  		CAMERA_IO_Write(DeviceAddr, OV2640_JPEG[index][0], OV2640_JPEG[index][1]);
  		CAMERA_Delay(1);
  	}

  	for(index=0; index<(sizeof(OV2640_1280x960_JPEG)/2); index++)
  	{
  		CAMERA_IO_Write(DeviceAddr, OV2640_1280x960_JPEG[index][0], OV2640_1280x960_JPEG[index][1]);
  		CAMERA_Delay(1);
  	}
	  break;
  default:
    {
      break;
    }
  }
  //Selecciona el banco de registros DSP del OV2640
  CAMERA_IO_Write(0x60, 0xFF, 0x00);
  //Fuerza la salida del sensor a RGB565
  CAMERA_IO_Write(0x60, 0xDA, 0x08);   // RGB565
  //Ajusta el orden y empaquetado de bytes RGB
  CAMERA_IO_Write(0x60, 0xD7, 0x03);
}
